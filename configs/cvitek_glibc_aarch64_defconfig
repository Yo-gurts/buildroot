## configs/cvitek_glibc_aarch64_defconfig
```kconfig
BR2_aarch64=y
BR2_cortex_a53=y
BR2_BACKUP_SITE="https://sources.buildroot.net"
BR2_CPAN_MIRROR="https://cpan.metacpan.org"
BR2_TOOLCHAIN_EXTERNAL=y
BR2_TOOLCHAIN_EXTERNAL_CUSTOM=y
BR2_TOOLCHAIN_EXTERNAL_PATH="host-tools/gcc/arm-gnu-toolchain-11.3.rel1-x86_64-aarch64-none-linux-gnu"
BR2_TOOLCHAIN_EXTERNAL_CUSTOM_PREFIX="aarch64-none-linux-gnu"
BR2_TOOLCHAIN_EXTERNAL_GCC_11=y
BR2_TOOLCHAIN_EXTERNAL_HEADERS_4_20=y
BR2_TOOLCHAIN_EXTERNAL_CUSTOM_GLIBC=y
BR2_TOOLCHAIN_EXTERNAL_CXX=y
BR2_TOOLCHAIN_EXTERNAL_FORTRAN=y
BR2_TOOLCHAIN_EXTERNAL_INET_RPC=n
BR2_TOOLCHAIN_EXTERNAL_OPENMP=y

######################################## 登录信息 ########################################
BR2_TARGET_GENERIC_HOSTNAME="sophgo"
BR2_TARGET_GENERIC_ISSUE="Welcome to sophgo"
BR2_TARGET_GENERIC_ROOT_PASSWD="sophgo"
BR2_ROOTFS_OVERLAY="board/sophgo"

######################################## 文件系统 ########################################
BR2_TARGET_ROOTFS_EXT2=y
BR2_TARGET_ROOTFS_EXT2_4=y
BR2_TARGET_ROOTFS_EXT2_SIZE="200M"
```

## configs/cvitek_glibc_riscv64_defconfig
```kconfig
BR2_riscv=y
BR2_riscv_custom=y
BR2_RISCV_ISA_RVI=y
BR2_RISCV_ISA_RVM=y
BR2_RISCV_ISA_RVA=y
BR2_RISCV_ISA_RVF=y
BR2_RISCV_ISA_RVD=y
BR2_RISCV_ISA_RVC=y
BR2_RISCV_ISA_RVV0P7=y
BR2_RISCV_ISA_THEAD=y
BR2_TOOLCHAIN_EXTERNAL=y
BR2_TOOLCHAIN_EXTERNAL_CXX=y
BR2_TOOLCHAIN_EXTERNAL_OPENMP=y
BR2_TOOLCHAIN_EXTERNAL_GCC_10=y
BR2_TOOLCHAIN_EXTERNAL_HEADERS_5_10=y
BR2_TOOLCHAIN_EXTERNAL_CUSTOM=y
BR2_TOOLCHAIN_EXTERNAL_FORTRAN=y
BR2_TOOLCHAIN_EXTERNAL_INET_RPC=n
BR2_TOOLCHAIN_EXTERNAL_PATH="host-tools/gcc/riscv64-linux-x86_64"
BR2_TOOLCHAIN_EXTERNAL_CUSTOM_PREFIX="riscv64-unknown-linux-gnu"
BR2_TOOLCHAIN_EXTERNAL_CUSTOM_GLIBC=y

# BR2_GCC_TARGET_CPU="c906fdv"
# BR2_GCC_TARGET_ABI="lp64d"
# BR2_GCC_TARGET_MODE="medany"

######################################## 登录信息 ########################################
BR2_TARGET_GENERIC_HOSTNAME="sophgo"
BR2_TARGET_GENERIC_ISSUE="Welcome to sophgo"
BR2_TARGET_GENERIC_ROOT_PASSWD="sophgo"
BR2_ROOTFS_OVERLAY="board/sophgo"

######################################## 文件系统 ########################################
BR2_TARGET_ROOTFS_EXT2=y
BR2_TARGET_ROOTFS_EXT2_4=y
BR2_TARGET_ROOTFS_EXT2_SIZE="200M"
```

## configs/cvitek_glibc_x86_64_defconfig
```kconfig
BR2_x86_64=y
BR2_BACKUP_SITE="https://sources.buildroot.net"
BR2_CPAN_MIRROR="https://cpan.metacpan.org"
BR2_GCC_VERSION_12_X=y
BR2_KERNEL_HEADERS_5_10=y
BR2_TOOLCHAIN_BUILDROOT_CXX=y
BR2_TOOLCHAIN_BUILDROOT_GLIBC=y
# 静态库、动态库都生成
BR2_SHARED_STATIC_LIBS=y

######################################## 登录信息 ########################################
BR2_TARGET_GENERIC_HOSTNAME="sophgo"
BR2_TARGET_GENERIC_ISSUE="Welcome to sophgo"
BR2_TARGET_GENERIC_ROOT_PASSWD="sophgo"
BR2_ROOTFS_OVERLAY="board/sophgo"

######################################## 文件系统 ########################################
BR2_TARGET_ROOTFS_EXT2=y
BR2_TARGET_ROOTFS_EXT2_4=y
BR2_TARGET_ROOTFS_EXT2_SIZE="200M"
```

## configs/cvitek_musl_arm32_defconfig
```kconfig
BR2_arm=y
BR2_cortex_a53=y
BR2_BACKUP_SITE="https://sources.buildroot.net"
BR2_CPAN_MIRROR="https://cpan.metacpan.org"
BR2_TOOLCHAIN_EXTERNAL=y
BR2_TOOLCHAIN_EXTERNAL_CUSTOM=y
BR2_TOOLCHAIN_EXTERNAL_PATH="host-tools/gcc/arm-gnu-toolchain-11.3.rel1-x86_64-arm-none-linux-musleabihf"
BR2_TOOLCHAIN_EXTERNAL_CUSTOM_PREFIX="arm-none-linux-musleabihf"
BR2_TOOLCHAIN_EXTERNAL_GCC_11=y
BR2_TOOLCHAIN_EXTERNAL_HEADERS_5_10=y
BR2_TOOLCHAIN_EXTERNAL_CUSTOM_MUSL=y
BR2_TOOLCHAIN_EXTERNAL_CXX=y
BR2_TOOLCHAIN_EXTERNAL_FORTRAN=y
BR2_TOOLCHAIN_EXTERNAL_INET_RPC=n
BR2_TOOLCHAIN_EXTERNAL_OPENMP=n
BR2_TARGET_GENERIC_HOSTNAME="sg200x"
BR2_TARGET_GENERIC_ISSUE="Welcome to Sg200x"
BR2_TARGET_GENERIC_ROOT_PASSWD="sophgo"
BR2_ROOTFS_OVERLAY="board/sophgo"

########################################### 文件系统类型 ###########################################
### flash mount/erase/cp ... tools
BR2_PACKAGE_MTD=y

### EXT4
BR2_TARGET_ROOTFS_EXT2=y
BR2_TARGET_ROOTFS_EXT2_4=y
BR2_TARGET_ROOTFS_EXT2_SIZE="200M"

### squashfs
# BR2_TARGET_ROOTFS_SQUASHFS=y
# BR2_TARGET_ROOTFS_SQUASHFS4_XZ=y

### ubifs
# BR2_TARGET_ROOTFS_UBIFS=y
# BR2_TARGET_ROOTFS_UBIFS_LEBSIZE=0x1F000
# 对sophgo的流程来说，最后打包UBI镜像用脚本，所以这里不打包UBI镜像
	# BR2_TARGET_ROOTFS_UBI=y

### recovery cpio
# BR2_TARGET_ROOTFS_CPIO=y
# BR2_TARGET_ROOTFS_CPIO_GZIP=y

########################################### 编译选项 ###########################################
### both dynamic & static libs
BR2_SHARED_STATIC_LIBS=y

########################################### 调试工具 ###########################################

# ### GDB 工具
# BR2_PACKAGE_GDB=y
# BR2_PACKAGE_GDB_SERVER=y

# ### add qt5 support
# BR2_PACKAGE_QT5=y
# BR2_PACKAGE_QT5BASE_WIDGETS=y
# BR2_PACKAGE_QT5BASE_TSLIB=y
# BR2_PACKAGE_QT5MULTIMEDIA=y
# BR2_PACKAGE_QT5XMLPATTERNS=y

# ### lame
# BR2_PACKAGE_LAME=y

# ### ffmpeg
# BR2_PACKAGE_FFMPEG=y
# BR2_PACKAGE_FFMPEG_FFPROBE=y
# BR2_PACKAGE_FFMPEG_AVRESAMPLE=y
# BR2_PACKAGE_FFMPEG_SWSCALE=y
# BR2_PACKAGE_FFMPEG_EXTRACONF="--enable-libmp3lame"

# ### file
# BR2_PACKAGE_FILE=y

# ### alsa_utils
# BR2_PACKAGE_ALSA_UTILS=y
# BR2_PACKAGE_ALSA_UTILS_ALSACONF=y
# BR2_PACKAGE_ALSA_UTILS_ALSACTL=y
# BR2_PACKAGE_ALSA_UTILS_ALSAMIXER=y
# BR2_PACKAGE_ALSA_UTILS_AMIXER=y
# BR2_PACKAGE_ALSA_UTILS_APLAY=y

# ### alsa_lib
# BR2_PACKAGE_ALSA_LIB=y

# ### mdev
# BR2_PACKAGE_MDEV=y

# ### sqlite
# BR2_PACKAGE_SQLITE=y
# BR2_PACKAGE_RKSCRIPT_ADBD_ONSTART=y

# ### flac
# BR2_PACKAGE_FLAC=y

# ### unzip
# BR2_PACKAGE_UNZIP=y

# ### zip
# BR2_PACKAGE_ZIP=y

# ### gzip
# BR2_PACKAGE_GZIP=y

# ### speex
# BR2_PACKAGE_SPEEX=y

# ### curl
# BR2_PACKAGE_LIBCURL=y
# BR2_PACKAGE_LIBCURL_CURL=y
# BR2_PACKAGE_LIBCURL_VERBOSE=n
# BR2_PACKAGE_LIBCURL_PROXY_SUPPORT=y
# BR2_PACKAGE_LIBCURL_WEBSOCKETS_SUPPORT=y
# BR2_PACKAGE_LIBCURL_COOKIES_SUPPORT=y
# BR2_PACKAGE_LIBCURL_EXTRA_PROTOCOLS_FEATURES=n
# # 云信用的libcurl不带SSL，不需要依赖openssl
# BR2_PACKAGE_LIBCURL_TLS_NONE=y
# # 云信这边用的 libcurl 没有启用 c_ares，必须设置为N 否则云信还需要加依赖库
# BR2_PACKAGE_C_ARES=n

# ### libqrencode
# BR2_PACKAGE_LIBQRENCODE=y

# ### cjson
# BR2_PACKAGE_CJSON=y

# ### mbedtls
# BR2_PACKAGE_MBEDTLS=y

# ### libuwsc
# BR2_PACKAGE_LIBUWSC=y

# ### libopenssl
# BR2_PACKAGE_OPENSSL=y

# ### libpng
# BR2_PACKAGE_LIBPNG=y

# ### jpeg
# BR2_PACKAGE_JPEG=y

# ### jpeg-turbo
# BR2_PACKAGE_JPEG_TURBO=y

# ### e2fsprogs
# BR2_PACKAGE_E2FSPROGS=y

# ### libiconv
# BR2_PACKAGE_LIBICONV=y

# ### bash
# BR2_PACKAGE_BUSYBOX_SHOW_OTHERS=y
# BR2_PACKAGE_BASH=y
# # busybox 默认shell用 bash，会导致 adb 的脚本运行报错
# # BR2_SYSTEM_BIN_SH_BASH=y

# ### libnl
# BR2_PACKAGE_LIBNL=y

# ### ntp
# BR2_PACKAGE_NTP=y

# ### libevent
# BR2_PACKAGE_LIBEVENT=y

# ### freetype
# BR2_PACKAGE_FREETYPE=y

# ### wireless_tools
# BR2_PACKAGE_WIRELESS_TOOLS=y

# ### wpa
# BR2_PACKAGE_WPA_SUPPLICANT=y
# BR2_PACKAGE_WPA_SUPPLICANT_AUTOSCAN=y
# BR2_PACKAGE_WPA_SUPPLICANT_CLI=y
# BR2_PACKAGE_WPA_SUPPLICANT_WPA_CLIENT_SO=y
# BR2_PACKAGE_WPA_SUPPLICANT_PASSPHRASE=y

# ### dhcpcd
# BR2_PACKAGE_DHCPCD=y

# ### ncurses
# BR2_PACKAGE_NCURSES=y

# ### dnsmasq
# BR2_PACKAGE_DNSMASQ=y

# ### readline
# BR2_PACKAGE_READLINE=y

# ### libdrm
# BR2_PACKAGE_LIBDRM=y
# BR2_PACKAGE_LIBDRM_INSTALL_TESTS=y

# ### iputils
# BR2_PACKAGE_IPUTILS=y

# ### android-tools
# BR2_PACKAGE_ANDROID_TOOLS=y
# BR2_PACKAGE_ANDROID_TOOLS_AUTH_PASSWORD="sophgo"

# ### zlog
# BR2_PACKAGE_ZLOG=y

# ### libubox
# BR2_PACKAGE_LIBUBOX=y

# ### tinyalsa
# BR2_PACKAGE_TINYALSA=y
# BR2_PACKAGE_TINYALSA_TOOLS=y

# ### libzlib
# BR2_PACKAGE_LIBZLIB=y

# ### ubus
# BR2_PACKAGE_UBUS=y

# ### libev
# BR2_PACKAGE_LIBEV=y

# ### evtest
# BR2_PACKAGE_EVTEST=y

# ### libogg
# BR2_PACKAGE_LIBOGG=y

# ### vendor_storage
# BR2_PACKAGE_VENDOR_STORAGE=y

# ### send_event
# BR2_PACKAGE_SEND_EVENT=y

# ### ifupdown-scripts
# BR2_PACKAGE_IFUPDOWN_SCRIPTS=y

# ### tzdata
# BR2_PACKAGE_TZDATA=y

# ### urandom-scripts
# BR2_PACKAGE_URANDOM_SCRIPTS=y

# ### initscripts
# BR2_PACKAGE_INITSCRIPTS=y
```
